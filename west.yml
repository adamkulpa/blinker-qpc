## west.yml
```yaml
# The west manifest file for upstream blinker-qpc.
# 
# See the west documentation for more information.

manifest:
  defaults:
    remote: upstream

  remotes:
    - name: upstream
      url-base: github.com/adamkulpa
  #
  # Please add items below based on alphabetical order
  projects:
    - name: qpc
      url: https://github.com/QuantumLeaps/qpc
      revision: cbf328b511740739680d4d1f28a0de23c095ea5a
      path: modules/qpc

  self:
    path: blinker-qpc
```
